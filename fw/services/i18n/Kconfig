## fw/services/i18n/Kconfig
```kconfig
# SPDX-FileCopyrightText: 2026 Core Devices LLC
# SPDX-License-Identifier: Apache-2.0

config SERVICE_I18N
    bool "Internationalization"
    help
      Internationalization (gettext) runtime support for installed
      language packs. Firmware includes only the English source strings.

if SERVICE_I18N

config SERVICE_I18N_KOREAN
    bool "Built-in Korean and TUMBLED fonts"
    default y if BOARD_OBELIX || BOARD_QEMU_EMERY
    help
      Include Korean strings and Korean/Japanese TUMBLED font subsets
      on Time 2 without changing the flash partition layout.

module = SERVICE_I18N
module-str = Internationalization
source "subsys/logging/Kconfig.template.log_level"

endif
```

## src/fw/services/i18n/Kconfig
```kconfig
# SPDX-FileCopyrightText: 2026 Core Devices LLC
# SPDX-License-Identifier: Apache-2.0

config SERVICE_I18N
    bool "Internationalization"
    help
      Internationalization (gettext) runtime support.

if SERVICE_I18N

config SERVICE_I18N_BUILTIN_LANGUAGES
    bool "Built-in language catalogs"
    default y
    help
      Ship the translated string catalogs in the system resource pack,
      so the languages can be picked from Settings straight away. When
      disabled the firmware only speaks English until a language pack
      is installed from the phone. The catalogs are a third of the
      resource pack, so boards with a small resource bank turn this
      off.

config SERVICE_I18N_KOREAN
    bool "Built-in Korean and TUMBLED fonts"
    depends on SERVICE_I18N_BUILTIN_LANGUAGES
    default y if BOARD_OBELIX || BOARD_QEMU_EMERY
    help
      Include Korean strings and Korean/Japanese TUMBLED font subsets
      on Time 2 without changing the flash partition layout.

module = SERVICE_I18N
module-str = Internationalization
source "subsys/logging/Kconfig.template.log_level"

endif
```
