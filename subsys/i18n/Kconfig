## subsys/i18n/Kconfig
```kconfig
# SPDX-FileCopyrightText: 2026 Core Devices LLC
# SPDX-License-Identifier: Apache-2.0

config I18N
    bool "Internationalization"
    help
      Translates strings with a gettext message catalog. Without a
      catalog, the English source strings are used.

if I18N

config I18N_KOREAN
    bool "Built-in Korean and TUMBLED fonts"
    default y if BOARD_OBELIX || BOARD_QEMU_EMERY
    help
      Include Korean strings and Korean/Japanese TUMBLED font subsets
      on Time 2 without changing the flash partition layout.

module = I18N
module-str = Internationalization
source "subsys/logging/Kconfig.template.log_level"

endif
```
